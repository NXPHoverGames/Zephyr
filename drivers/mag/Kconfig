## drivers/mag/Kconfig
```kconfig
# GNSS configuration options

# Copyright (c) 2022 Abel Sensors
# SPDX-License-Identifier: Apache-2.0

rsource "ist8310/Kconfig"
```

## drivers/sensor/fxls8961af/Kconfig
```kconfig
# FXLS8961AF 3-axis accelerometer

# Copyright 2023 NXP
# SPDX-License-Identifier: Apache-2.0

menuconfig FXLS8961AF
	bool "FXLS8961AF MAG Module"
	help
		Enable the driver for FXLS8961AF accelerometer.

if FXLS8961AF

module = FXLS8961AF
module-str = fxls8961af
source "subsys/logging/Kconfig.template.log_config"

config FXLS8961AF_INIT_PRIORITY
	int "Counter init priority"
	default 80
	help
		FXLS8961AF driver device initialization priority.

endif # FXLS8961AF
```

## dts/bindings/gnss/ublox,neom8.yaml
```yaml
# Copyright (c) 2022 Abel Sensors
# SPDX-License-Identifier: Apache-2.0

description: U-blox NEO-M8 GNSS Module

compatible: "u-blox,neom8"

include: uart-device.yaml
include: i2c-device.yaml
```

## dts/bindings/mag/ist8310.yaml
```yaml
# Copyright (c) 2022 Abel Sensors
# SPDX-License-Identifier: Apache-2.0

description: IST8310 MAG Module

compatible: "ist8310"

include: i2c-device.yaml
```

## dts/bindings/sensor/nxp,fxls8961af-common.yaml
```yaml
# Copyright 2023 NXP
# SPDX-License-Identifier: Apache-2.0

description: FXLS8961AF 3-axis accelerometer sensor

include: sensor-device.yaml
```

## dts/bindings/sensor/nxp,fxls8961af-i2c.yaml
```yaml
# Copyright 2023 NXP
# SPDX-License-Identifier: Apache-2.0

description: FXLS8961AF 3-axis accelerometer sensor

compatible: "nxp,fxls8961af"

include: ["i2c-device.yaml", "nxp,fxls8961af-common.yaml"]
```

## dts/bindings/sensor/nxp,fxls8961af-spi.yaml
```yaml
# Copyright 2023 NXP
# SPDX-License-Identifier: Apache-2.0

description: FXLS8961AF 3-axis accelerometer sensor

compatible: "nxp,fxls8961af"

include: ["spi-device.yaml", "nxp,fxls8961af-common.yaml"]
```

## samples/net/sockets/can/Kconfig
```kconfig
# Private config options for can sample app

# Copyright (c) 2018 Alexander Wachter
# SPDX-License-Identifier: Apache-2.0

mainmenu "SocketCAN sample application"

config SAMPLE_SOCKETCAN_LOOPBACK_MODE
	bool "Loopback mode"
	default y
	help
	  Set the controller to loopback mode.
	  This allows testing without a second board.

config NET_SOCKETS_CAN_TRANSMITTERS
	int "Number of Transmitters"
	default 1
	help
	  Set the number of transmitters.
	  This allows testing wit multiple transmitters.


source "Kconfig.zephyr"
```
